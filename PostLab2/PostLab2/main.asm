;UNIVERSIDAD DEL VALLE DE GUATEMALA
;IE2023: PROGRAMACIсN DE MICROCONTROLADORES
;Laboratorio1.asm
;AUTOR: Eber Alexander CuxИ Tan
;PROYECTO: Contador binario de 4 bits
;HARDWARE: ATMEGA328P
;CREADO: 30/01/2024
;зLTIMA MODIFICACIсN: 30/01/2024 17:19

.INCLUDE "M328PDEF.INC"
.CSEG
.ORG 0X00

;STACK POINTER SPL SPH
LDI R16, LOW(RAMEND)
OUT SPL, R16
LDI R17, HIGH(RAMEND)
OUT SPH, R17

;TABLA
//SEG: .DB 0x3F,0x06,0x5B,0x4F,0x66,0x6D,0x7D,0x0F,0x7F,0x6F,0x77,0x7C,0x39,0x9E,0x79,0x71
SEG: .DB 63,6,91,79,102,109,125,7,127,111,119,124,57,158,121,113

SETUP:
	LDI R29, 0X05			;SET A VALUE FOR SHOWING

	;BUTTONS
	LDI R16, 0x03			;SELECT PC0 - PC1 AS OUTPUT WITH PULL-UP ON
	OUT PORTC, R16			;SAVE SETTING OF PORT

	LDI R16, 0x00
	OUT DDRC, R16			;ALL PINC AS INPUT

	;7SEG
	LDI R16, 0x3F
	OUT DDRB, R16			;SET PB0 - PB5 AS OUTPUT

	LDI R16, 0XFC
	OUT DDRD, R16			;SET PD2 - PD7 AS OUTPUT

	CALL TIMER
	LDI R20, 0
	LDI R30, 0

		

LOOP:

	;BOTONES
	IN R16, PINC			;READING THE ENTIRE REGISTER OF PORTC
	SBRS R16, PC0			;READING PC0, INCREASE, IF IT'S 1 SKIPS NEXT INSTR.
	RJMP INCREASE			;CALLING INCREASE

	IN R17, PINC
	SBRS R17, PC1			;READING PC1, DECREASE, IF IT'S 1 SKIPS NEXT INSTR.
	RJMP DECREASE
	

	;TIMER
	IN R26, TIFR0
	CPI R26, (1 << TOV0)	;IF FLAG IS NOT SETTED RESTART
	BRNE LOOP

	CPI R20, 15
	BREQ ZERO

	LDI R26, 100			;LOAD OVERFLOW VALUE AGAIN
	OUT TCNT0, R26

	SBI TIFR0, TOV0			

	INC R30
	CPI R30, 100
	BRNE LOOP
	CLR R30	
	
	INC R20
	MOV R25, R20
	LSL R25
	LSL R25
	OUT PORTD, R25


	;VERIFICAR EN LA LISTA
	LDI ZH, HIGH(SEG << 1)
	LDI ZL, LOW(SEG << 1)
	ADD ZL, R29				;VER POS EN LA LISTA
	LPM R21, Z				;GUARDAR CONTEO

	;SEGMENTO G
	SBRC R21, 7				;IF BIT7 IS ZERO, IT JUMPS
	SBI PORTD, PD7			;IT SETS PD7
	SBRS R21, 7				;IF BIT7 IS 1, IT JUMPS
	CBI PORTC, PD7			;IT CLEARS PD7
	OUT PORTB, R21
	
	;VER "ALARMA"
	CP R29, R20
	BRNE LOOP
	SBI PORTD, PD6
	
	MOV R23, R20
	CP R29, R23
	BRNE LOOP
	LDI R20, 0

	RJMP LOOP


;*****SUBROUTINES*****
DELAYBOUNCE:
	IN R26, TIFR0
	CPI R26, (1 << TOV0)	;IF FLAG IS NOT SETTED RESTART
	BRNE DELAYBOUNCE
	LDI R26, 100			;LOAD OVERFLOW VALUE AGAIN
	OUT TCNT0, R26
	SBI TIFR0, TOV0			
	INC R30
	CPI R30, 100
	BRNE DELAYBOUNCE
	CLR R30

	SBIS PINC, (PC1 & PC0)	;IT SKIPS NEXT INSTR. IF REGISTER IS 1
	RJMP DELAYBOUNCE
	RJMP LOOP

INCREASE:
	INC R29					;R19 EXCLUSIVE FOR COUNTING
	RJMP DELAYBOUNCE

DECREASE:
	DEC R29
	RJMP DELAYBOUNCE

ZERO:
	LDI R20, 0XFF

TIMER:
	LDI R27, (1 << CS02) | (1 << CS00)	;SET PRESCALER AT 1024
	OUT TCCR0B, R27

	LDI R27, 100			;VALUE OF OVERFLOW
	OUT TCNT0, R27			;INITIAL VALUE FOR COUNTER/TIMER
	RET