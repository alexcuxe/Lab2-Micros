;UNIVERSIDAD DEL VALLE DE GUATEMALA
;IE2023: PROGRAMACIсN DE MICROCONTROLADORES
;Laboratorio1.asm
;AUTOR: Eber Alexander CuxИ Tan
;PROYECTO: Contadores binarios de 4 bits AUTO
;HARDWARE: ATMEGA328P
;CREADO: 06/02/2024
;зLTIMA MODIFICACIсN: 30/01/2024 14:25

.INCLUDE "M328PDEF.INC"
.CSEG
.ORG 0X00

;STACK POINTER SPL SPH
LDI R16, LOW(RAMEND)
OUT SPL, R16
LDI R17, HIGH(RAMEND)
OUT SPH, R17


SETUP:
	LDI R17, 0x03			;SELECT PC0 - PC1 AS INPUT WITH PULL-UP ON
	OUT PORTC, R17			;SAVE SETTING OF PORT, DEFAULT, INPUTS (0)

	LDI R16, 0x3F
	OUT DDRB, R16			;SET PB0 - PB5 AS OUTPUT

	LDI R16, 0xFC
	OUT DDRD, R16			;PD2 - PD7 AS OUTPUT

	CALL TIMER

	LDI R20, 0
	LDI R30, 0

LOOP:
	IN R16, TIFR0
	CPI R16, (1 << TOV0)	;IF FLAG IS NOT SETTED RESTART
	BRNE LOOP

	CPI R20, 16
	BREQ ZERO

	LDI R16, 100			;LOAD OVERFLOW VALUE AGAIN
	OUT TCNT0, R16

	SBI TIFR0, TOV0			

	INC R30
	CPI R30, 10
	BRNE LOOP
	CLR R30	
	
	INC R20
	MOV R25, R20
	LSL R25
	LSL R25
	OUT PORTD, R25

	RJMP LOOP

ZERO:
	LDI R20, 0

TIMER:
	LDI R16, (1 << CS02) | (1 << CS00)	;SET PRESCALER AT 1024
	OUT TCCR0B, R16

	LDI R16, 100			;VALUE OF OVERFLOW
	OUT TCNT0, R16			;INITIAL VALUE FOR COUNTER/TIMER
	RET