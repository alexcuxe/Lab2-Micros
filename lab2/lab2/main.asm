;UNIVERSIDAD DEL VALLE DE GUATEMALA
;IE2023: PROGRAMACIсN DE MICROCONTROLADORES
;Laboratorio1.asm
;AUTOR: Eber Alexander CuxИ Tan
;PROYECTO: Contador binario de 4 bits
;HARDWARE: ATMEGA328P
;CREADO: 30/01/2024
;зLTIMA MODIFICACIсN: 30/01/2024 17:19

.INCLUDE "M328PDEF.INC"
.CSEG
.ORG 0X00

;STACK POINTER SPL SPH
LDI R16, LOW(RAMEND)
OUT SPL, R16
LDI R17, HIGH(RAMEND)
OUT SPH, R17

;TABLA
//SEG: .DB 0x3F,0x06,0x5B,0x4F,0x66,0x6D,0x7D,0x0F,0x7F,0x6F,0x77,0x7C,0x39,0x9E,0x79,0x71
SEG: .DB 63,6,91,79,102,109,125,7,127,111,119,124,57,158,121,0X71

SETUP:
	LDI R19, 0X00			;SET A VALUE FOR SHOWING

	//LDI R18,1
	
	//ADD ZL, R18
	//LPM R18, Z

	LDI R16, (1 << CLKPCE)	;PRESCALER ENABLE
	STS CLKPR, R16

	LDI R16, 0X03			;16MHz / 8
	STS CLKPR, R16			;FREC: 2MHz

	;BUTTONS
	LDI R16, 0x03			;SELECT PC0 - PC1 AS OUTPUT WITH PULL-UP ON
	OUT PORTC, R16			;SAVE SETTING OF PORT

	LDI R16, 0x00
	OUT DDRC, R16			;ALL PINC AS INPUT

	;7SEG
	LDI R16, 0x3F
	OUT DDRB, R16			;SET PB0 - PB5 AS OUTPUT

	LDI R16, 0XFC
	OUT DDRD, R16			;SET PD2 - PD7 AS OUTPUT
		

LOOP:

	IN R16, PINC			;READING THE ENTIRE REGISTER OF PORTC}
	SBRS R16, PC0			;READING PC0, INCREASE, IF IT'S 1 SKIPS NEXT INSTR.
	RJMP INCREASE			;CALLING INCREASE

	IN R17, PINC
	SBRS R17, PC1			;READING PC1, DECREASE, IF IT'S 1 SKIPS NEXT INSTR.
	RJMP DECREASE
	
	//MOV R18, R19
	LDI ZH, HIGH(SEG << 1)
	LDI ZL, LOW(SEG << 1)
	ADD ZL, R19
	LPM R21, Z

	SBRC R21, 7				;IF BIT7 IS ZERO, IT JUMPS
	SBI PORTD, PD7			;IT SETS PD7
	SBRS R21, 7				;IF BIT7 IS 1, IT JUMPS
	CBI PORTC, PD7			;IT CLEARS PD7
	OUT PORTB, R21
	
	

	RJMP LOOP


;*****SUBROUTINES*****
DELAYBOUNCE:
	LDI R16, 0			;IT WAITS 75 U. OF TIME
	LDI R17, 0
	DELAY:
		DEC R16				;DECREASE R16
		BRNE DELAY			;IF R16 IS NOT 0 RETURN TO DELAY
		DEC R17
		BRNE DELAY
	
	SBIS PINC, (PC1 & PC0)	;IT SKIPS NEXT INSTR. IF REGISTER IS 1
	RJMP DELAYBOUNCE
	RJMP LOOP

INCREASE:
	INC R19					;R19 EXCLUSIVE FOR COUNTING
	CPI R19, 15
	BREQ LOOP
	RJMP DELAYBOUNCE

DECREASE:
	DEC R19
	CPI R19, 0
	BREQ LOOP
	RJMP DELAYBOUNCE



;VALUES FOR DISPLAY
//7SEG: .DB 0x3F,0x06,0x5B,0x4F,0x66,0x6D,0x7D,0x0F,0x7F,0x6F,0x77,0x7C,0x39,0x9E,0x79,0x71
//7SEG: .DB 63,6,91,,79,102,,109,125,15,,127,111,119,124,57,158,121,113